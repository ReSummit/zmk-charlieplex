## app/boards/shields/011/Kconfig.defconfig
```kconfig
# Copyright (c) 2022 The ZMK Contributors
# SPDX-License-Identifier: MIT

if SHIELD_011

config ZMK_KEYBOARD_NAME
    default "011"

endif
```

## app/boards/shields/diff_direct/Kconfig.shield
```kconfig
# Copyright (c) 2021 The ZMK Contributors
# SPDX-License-Identifier: MIT

config SHIELD_DIFF_DIRECT
    def_bool $(shields_list_contains,diff_direct)
```

## app/boards/shields/diff_matrix/Kconfig.defconfig
```kconfig
# Copyright (c) 2021 The ZMK Contributors
# SPDX-License-Identifier: MIT

if SHIELD_DIFF_MATRIX

config ZMK_KEYBOARD_NAME
    default "diff_matrix"

config ZMK_USB_LOGGING
    default y
endif
```

## app/boards/shields/diff_matrix/Kconfig.shield
```kconfig
# Copyright (c) 2021 The ZMK Contributors
# SPDX-License-Identifier: MIT

config SHIELD_DIFF_MATRIX
    def_bool $(shields_list_contains,diff_matrix)
```

## app/boards/shields/diff_rr/Kconfig.defconfig
```kconfig
# Copyright (c) 2021 The ZMK Contributors
# SPDX-License-Identifier: MIT

if SHIELD_DIFF_RR

config ZMK_KEYBOARD_NAME
    default "Bat43"

config ZMK_USB_LOGGING
    default y
endif
```

## app/boards/shields/diff_rr/Kconfig.shield
```kconfig
# Copyright (c) 2021 The ZMK Contributors
# SPDX-License-Identifier: MIT

config SHIELD_DIFF_RR
    def_bool $(shields_list_contains,diff_rr)
```
